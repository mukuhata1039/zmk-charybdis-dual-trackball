## boards/shields/charybdis_dual/Kconfig.defconfig
```kconfig
if SHIELD_CHARYBDIS_DUAL_DONGLE

config ZMK_KEYBOARD_NAME
    default "CharyDual"

config ZMK_SPLIT_ROLE_CENTRAL
    default y

config ZMK_SPLIT_BLE_CENTRAL_PERIPHERALS
    default 2

config BT_MAX_CONN
    default 7

config BT_MAX_PAIRED
    default 7

endif


if SHIELD_CHARYBDIS_DUAL_DONGLE || SHIELD_CHARYBDIS_DUAL_LEFT || SHIELD_CHARYBDIS_DUAL_RIGHT

config ZMK_SPLIT
    default y

endif
```

## boards/shields/charybdis_dual/Kconfig.shield
```kconfig
config SHIELD_CHARYBDIS_DUAL_DONGLE
    def_bool $(shields_list_contains,charybdis_dual_dongle)

config SHIELD_CHARYBDIS_DUAL_LEFT
    def_bool $(shields_list_contains,charybdis_dual_left)

config SHIELD_CHARYBDIS_DUAL_RIGHT
    def_bool $(shields_list_contains,charybdis_dual_right)
```

## config/west.yml
```yaml
manifest:
  defaults:
    revision: main

  remotes:
    - name: zmkfirmware
      url-base: https://github.com/zmkfirmware

    - name: badjeff
      url-base: https://github.com/badjeff

  projects:
    - name: zmk
      remote: zmkfirmware
      import: app/west.yml

    - name: zmk-input-processor-xyz
      remote: badjeff
      revision: edb44b7

  self:
    path: config
```

## dts/bindings/input_processors/zmk,input-processor-usb-suspend-blocker.yaml
```yaml
description: Block selected pointing input while USB host is suspended

compatible: "zmk,input-processor-usb-suspend-blocker"

include: ip_zero_param.yaml
```
